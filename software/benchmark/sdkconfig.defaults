## software/benchmark/sdkconfig.defaults
```kconfig
CONFIG_IDF_TARGET="esp32s3"
CONFIG_ESP_DEFAULT_CPU_FREQ_MHZ_240=y
CONFIG_ESPTOOLPY_FLASHSIZE_16MB=y
CONFIG_ESPTOOLPY_FLASHMODE_QIO=y
CONFIG_SPIRAM=y
CONFIG_SPIRAM_MODE_OCT=y
CONFIG_SPIRAM_SPEED_80M=y
CONFIG_SPIRAM_BOOT_INIT=y
CONFIG_SPIRAM_ALLOW_STACK_EXTERNAL_MEMORY=y
CONFIG_SPIRAM_USE_MALLOC=y
CONFIG_SPIRAM_MALLOC_ALWAYSINTERNAL=4096
CONFIG_PARTITION_TABLE_CUSTOM=y
CONFIG_PARTITION_TABLE_CUSTOM_FILENAME="partitions_bench.csv"
CONFIG_FREERTOS_HZ=1000
CONFIG_LOG_DEFAULT_LEVEL_INFO=y
CONFIG_ESP_MAIN_TASK_STACK_SIZE=65536
CONFIG_ESP_TASK_WDT_EN=n
CONFIG_ESP_INT_WDT=n
CONFIG_SPIFFS_PAGE_SIZE=256
CONFIG_SPIFFS_OBJ_NAME_LEN=64
CONFIG_SPIFFS_MAX_PARTITIONS=3
```

## software/sdkconfig.defaults
```kconfig
# ESP32 Emu Turbo — sdkconfig defaults for ESP32-S3 N16R8

# Target
CONFIG_IDF_TARGET="esp32s3"

# CPU — 240 MHz dual-core
CONFIG_ESP_DEFAULT_CPU_FREQ_MHZ_240=y

# Flash — 16 MB QIO 80 MHz
CONFIG_ESPTOOLPY_FLASHSIZE_16MB=y
CONFIG_ESPTOOLPY_FLASHMODE_QIO=y
CONFIG_ESPTOOLPY_FLASHFREQ_80M=y

# PSRAM — 8 MB Octal 80 MHz
CONFIG_SPIRAM=y
CONFIG_SPIRAM_MODE_OCT=y
CONFIG_SPIRAM_SPEED_80M=y
CONFIG_SPIRAM_BOOT_INIT=y
CONFIG_SPIRAM_ALLOW_STACK_EXTERNAL_MEMORY=y

# Partition table — custom CSV
CONFIG_PARTITION_TABLE_CUSTOM=y
CONFIG_PARTITION_TABLE_CUSTOM_FILENAME="partitions.csv"

# FAT filesystem — long filenames for ROM files
CONFIG_FATFS_LONG_FILENAMES=y
CONFIG_FATFS_LFN_HEAP=y
CONFIG_FATFS_MAX_LFN=255

# FreeRTOS tick rate — 1 kHz for 1 ms polling resolution
CONFIG_FREERTOS_HZ=1000

# Log level — Info (for development)
CONFIG_LOG_DEFAULT_LEVEL_INFO=y

# USB-CDC console — route ESP_LOGx output through USB-C port
# (no UART TX/RX GPIOs are routed on PCB)
CONFIG_ESP_CONSOLE_USB_SERIAL_JTAG=y

# Task watchdog — 10s timeout for emulation frames
CONFIG_ESP_TASK_WDT_TIMEOUT_S=10

# Main task stack — display+SD+audio init need ~6KB (default 3584 too small)
CONFIG_ESP_MAIN_TASK_STACK_SIZE=8192
```
