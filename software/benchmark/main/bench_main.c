/**
 * ESP32 Emu Turbo — QEMU CPU Benchmark (entry point)
 * ROMs embedded in flash via EMBED_FILES.
 */
#include <stdio.h>
#include <stdlib.h>
#include <string.h>
#include "esp_timer.h"
#include "esp_heap_caps.h"
#include "esp_log.h"
#include "freertos/FreeRTOS.h"
#include "freertos/task.h"
#include "bench.h"

static const char *TAG = "BENCH";

/* Embedded ROM symbols (generated by EMBED_FILES) */
extern const uint8_t rom_nes_start[] asm("_binary_owlia_nes_start");
extern const uint8_t rom_nes_end[]   asm("_binary_owlia_nes_end");
extern const uint8_t rom_gb_start[]  asm("_binary_blarggs_cpu_instrs_gb_start");
extern const uint8_t rom_gb_end[]    asm("_binary_blarggs_cpu_instrs_gb_end");
extern const uint8_t rom_sms_start[] asm("_binary_silvervalley_sms_start");
extern const uint8_t rom_sms_end[]   asm("_binary_silvervalley_sms_end");
extern const uint8_t rom_gbc_start[] asm("_binary_ucity_gbc_start");
extern const uint8_t rom_gbc_end[]   asm("_binary_ucity_gbc_end");
extern const uint8_t rom_gg_start[]  asm("_binary_Swabby_GG_1_11_gg_start");
extern const uint8_t rom_gg_end[]    asm("_binary_Swabby_GG_1_11_gg_end");
extern const uint8_t rom_pce_start[]  asm("_binary_reflectron_pce_start");
extern const uint8_t rom_pce_end[]    asm("_binary_reflectron_pce_end");
extern const uint8_t rom_snes_start[] asm("_binary_superbossgaiden_sfc_start");
extern const uint8_t rom_snes_end[]   asm("_binary_superbossgaiden_sfc_end");

/* ── Shared utilities ────────────────────────────────── */

uint8_t *bench_load_file(const char *path, size_t *out_size) {
    /* Not used with embedded ROMs, but kept for API compat */
    (void)path; (void)out_size;
    return NULL;
}

uint8_t *bench_load_embedded(const uint8_t *start, const uint8_t *end, size_t *out_size) {
    *out_size = end - start;
    /* Copy to PSRAM so cores can modify if needed */
    uint8_t *buf = heap_caps_malloc(*out_size, MALLOC_CAP_SPIRAM);
    if (buf) memcpy(buf, start, *out_size);
    ESP_LOGI(TAG, "Loaded embedded ROM (%zu KB)", *out_size / 1024);
    return buf;
}

void bench_print_result(const char *label, int frames, int64_t elapsed_us) {
    float avg = (float)elapsed_us / frames;
    float fps = 1000000.0f / avg;
    printf("[BENCH] %-6s: %d frames in %lld us, avg %.0f us/frame, %.1f fps %s\n",
           label, frames, (long long)elapsed_us, avg, fps,
           fps >= 60.0f ? "(OK)" : "(SLOW)");
}

/* ── Main ────────────────────────────────────────────── */

void app_main(void) {
    printf("\n");
    printf("============================================\n");
    printf("  ESP32 Emu Turbo — QEMU CPU Benchmark\n");
    printf("  CPU: ESP32-S3 LX7 @ 240MHz (emulated)\n");
    printf("  PSRAM: 8MB Octal\n");
    printf("  Warmup: %d frames, Bench: %d frames\n", WARMUP_FRAMES, BENCH_FRAMES);
    printf("============================================\n\n");

    ESP_LOGI(TAG, "Free heap: %zu, free PSRAM: %zu",
             heap_caps_get_free_size(MALLOC_CAP_8BIT),
             heap_caps_get_free_size(MALLOC_CAP_SPIRAM));

    printf("\n--- Running benchmarks ---\n\n");

    /* SNES first — needs most memory */
    size_t sz;
    uint8_t *rom = bench_load_embedded(rom_snes_start, rom_snes_end, &sz);
    if (rom) { bench_snes_rom(rom, sz); }

    /* NES */
    rom = bench_load_embedded(rom_nes_start, rom_nes_end, &sz);
    if (rom) { bench_nes_rom(rom, sz); }

    /* GB */
    rom = bench_load_embedded(rom_gb_start, rom_gb_end, &sz);
    if (rom) { bench_gb_rom(rom, sz, "GB"); }

    /* GBC */
    rom = bench_load_embedded(rom_gbc_start, rom_gbc_end, &sz);
    if (rom) { bench_gb_rom(rom, sz, "GBC"); }

    /* SMS */
    rom = bench_load_embedded(rom_sms_start, rom_sms_end, &sz);
    if (rom) { bench_sms_rom(rom, sz, "SMS"); }

    /* GG */
    rom = bench_load_embedded(rom_gg_start, rom_gg_end, &sz);
    if (rom) { bench_sms_rom(rom, sz, "GG"); }

    /* PCE */
    rom = bench_load_embedded(rom_pce_start, rom_pce_end, &sz);
    if (rom) { bench_pce_rom(rom, sz); }

    printf("\n============================================\n");
    printf("  Target: 60 fps = 16667 us/frame\n");
    printf("============================================\n");
    printf("BENCHMARK_COMPLETE\n");

    /* Keep alive for VNC viewing — idle loop */
    printf("\nIdling (QEMU display active)...\n");
    while (1) { vTaskDelay(pdMS_TO_TICKS(1000)); }
}
