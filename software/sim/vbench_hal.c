/**
 * ESP32 Emu Turbo — Virtual Bench HAL (T4.1 + T4.4)
 *
 * Drop-in replacement for sim_hal.c: same API, but the hardware behind it
 * is the BOARD MODEL, not wishful constants. Every number shown or applied
 * here comes from vbench_board.h, which is GENERATED by the Python bench
 * from the netlist, the BOM and cited datasheet parameters — this file
 * contains no electrical value of its own.
 *
 * What "running on the model" buys, concretely:
 *
 *   PIXELS   travel through the i80 bus model: each byte is permuted by
 *            VB_LCD_BUS_MAP, the DBn <- LCD_Dm mapping the bench derived
 *            from the netlist through the 41-N ribbon reversal. On this
 *            board the map is the identity, so the picture is untouched —
 *            but cross two data lines in the design and the simulator's
 *            picture scrambles. The bug becomes a thing you can see.
 *
 *   BUTTONS  pass through the RC network: a press shorts the node (fast),
 *            a release rises through 10k x 100nF and only reads HIGH after
 *            VB_BTN_T_RISE_US. BTN_L has no external RC (R14 is DNP because
 *            GPIO45 is a strapping pin) and releases instantly.
 *
 *   RESET    (F5) samples the strapping pins at that instant: SELECT held
 *            means GPIO0 low, which is Joint Download Boot — the app stops
 *            and the splash says so, exactly like the real chip.
 *
 *   SW16   (P) gates the +5V rail through Q2 (the respin). OFF removes
 *            +5V, and with it +3V3 and the MCU — there is no warning and
 *            no graceful-shutdown hook, the supply is simply gone. The
 *            cell path does NOT run through the switch, so the IP5306
 *            keeps charging; the instrument line says both.
 *
 *   The instrument strip (T4.4) is the bench test: per-rail voltmeters,
 *   an ammeter, junction temperatures, boot mode — and the calibration
 *   flag, which stays "no" until prototype #1 measurements land (T5.4).
 *
 * Build: make -C software/sim bench   (links this instead of sim_hal.c)
 */

#ifdef SIM_BUILD

#include "sim_hal.h"
#include "vbench_board.h"
#include "font8x8.h"
#include <stdio.h>
#include <stdlib.h>
#include <string.h>
#include <math.h>

/* ── Window layout: LCD on top, instrument strip below ───── */

#define VB_PANEL_H 104
#define VB_WIN_W SIM_LCD_WIDTH
#define VB_WIN_H (SIM_LCD_HEIGHT + VB_PANEL_H)

#define RGB565(r, g, b) ((uint16_t)((((r) >> 3) << 11) | (((g) >> 2) << 5) | ((b) >> 3)))
#define COL_BG    RGB565(12, 16, 24)
#define COL_TXT   RGB565(220, 224, 228)
#define COL_DIM   RGB565(130, 136, 146)
#define COL_OK    RGB565(80, 220, 120)
#define COL_WARN  RGB565(240, 200, 80)
#define COL_BAD   RGB565(240, 90, 90)

static SDL_Window   *g_window = NULL;
static SDL_Renderer *g_renderer = NULL;
static SDL_Texture  *g_texture = NULL;
static uint16_t      g_framebuffer[VB_WIN_W * VB_WIN_H];
static bool          g_quit = false;
static bool          g_back = false;

/* ── Bench state ─────────────────────────────────────────── */

typedef enum { SRC_USB, SRC_BATTERY } vb_source_t;

static vb_source_t g_source = SRC_USB;
static float       g_soc = 0.50f;
static bool        g_sw_pwr_on = true;      /* the slide switch position   */
static bool        g_download_mode = false; /* reset with SELECT held      */
static float       g_audio_level = 0.0f;    /* 0..1 of supply-allowed swing */
static uint8_t     g_bus_lut[256];          /* i80 byte permutation        */

/* Buttons: pressed state plus per-bit release deadline (RC rise). */
static uint16_t g_btn_state = 0;
static uint64_t g_btn_release_at[12];       /* perf-counter ticks; 0=none  */

static float vb_ocv(float soc) {
    if (soc <= VB_BAT_OCV[0].soc) return VB_BAT_OCV[0].v;
    for (int i = 1; i < VB_BAT_OCV_POINTS; i++) {
        if (soc <= VB_BAT_OCV[i].soc) {
            float s0 = VB_BAT_OCV[i-1].soc, v0 = VB_BAT_OCV[i-1].v;
            float s1 = VB_BAT_OCV[i].soc,   v1 = VB_BAT_OCV[i].v;
            return v0 + (v1 - v0) * (soc - s0) / (s1 - s0);
        }
    }
    return VB_BAT_OCV[VB_BAT_OCV_POINTS-1].v;
}

/* ── i80 bus model ───────────────────────────────────────── */

static void vb_build_bus_lut(void) {
    for (int in = 0; in < 256; in++) {
        uint8_t out = 0;
        for (int db = 0; db < 8; db++)
            if (in & (1u << VB_LCD_BUS_MAP[db]))
                out |= (uint8_t)(1u << db);
        g_bus_lut[in] = out;
    }
}

static inline uint16_t vb_bus_px(uint16_t px) {
    /* RGB565 crosses the 8-bit 8080 bus as two byte transfers; each byte
     * lands on DB0..DB7 through the derived map. */
    return (uint16_t)((g_bus_lut[(px >> 8) & 0xFF] << 8) | g_bus_lut[px & 0xFF]);
}

/* ── Text on the framebuffer (font8x8) ───────────────────── */

static void vb_char(int x, int y, char c, uint16_t fg) {
    if (c < 32 || c > 127) c = '?';
    const uint8_t *glyph = font8x8[c - 32];
    for (int r = 0; r < 8; r++)
        for (int b = 0; b < 8; b++)
            if (glyph[r] & (1u << b)) {
                int px = x + b, py = y + r;
                if (px >= 0 && px < VB_WIN_W && py >= 0 && py < VB_WIN_H)
                    g_framebuffer[py * VB_WIN_W + px] = fg;
            }
}

static void vb_text(int x, int y, const char *s, uint16_t fg) {
    for (; *s; s++, x += 8) vb_char(x, y, *s, fg);
}

/* ── Display API ─────────────────────────────────────────── */

int sim_display_init(void) {
    g_window = SDL_CreateWindow(
        "ESP32 Emu Turbo — Virtual Bench (model-backed)",
        SDL_WINDOWPOS_CENTERED, SDL_WINDOWPOS_CENTERED,
        VB_WIN_W, VB_WIN_H, SDL_WINDOW_SHOWN | SDL_WINDOW_RESIZABLE);
    if (!g_window) { fprintf(stderr, "SDL_CreateWindow: %s\n", SDL_GetError()); return -1; }
    g_renderer = SDL_CreateRenderer(g_window, -1,
        SDL_RENDERER_ACCELERATED | SDL_RENDERER_PRESENTVSYNC);
    if (!g_renderer) { fprintf(stderr, "SDL_CreateRenderer: %s\n", SDL_GetError()); return -1; }
    g_texture = SDL_CreateTexture(g_renderer, SDL_PIXELFORMAT_RGB565,
        SDL_TEXTUREACCESS_STREAMING, VB_WIN_W, VB_WIN_H);
    if (!g_texture) { fprintf(stderr, "SDL_CreateTexture: %s\n", SDL_GetError()); return -1; }
    SDL_RenderSetLogicalSize(g_renderer, VB_WIN_W, VB_WIN_H);
    memset(g_framebuffer, 0, sizeof(g_framebuffer));
    vb_build_bus_lut();
    printf("[VBENCH] window %dx%d: %dx%d LCD through the i80 model + %dpx instruments\n",
           VB_WIN_W, VB_WIN_H, SIM_LCD_WIDTH, SIM_LCD_HEIGHT, VB_PANEL_H);
    printf("[VBENCH] board %.24s...  calibration: %s\n", VB_PCB_HASH, VB_CALIBRATION);
    return 0;
}

void sim_display_write(const uint16_t *pixels, int x, int y, int w, int h) {
    /* In download mode the app is not running — the boot ROM owns the
     * screen, so app writes are dropped, as on the real chip. */
    if (g_download_mode || !VB_LCD_MODE_8080_8BIT) return;
    for (int row = 0; row < h && (y + row) < SIM_LCD_HEIGHT; row++) {
        uint16_t *dst = &g_framebuffer[(y + row) * VB_WIN_W + x];
        const uint16_t *src = &pixels[row * w];
        int copy_w = (x + w > SIM_LCD_WIDTH) ? (SIM_LCD_WIDTH - x) : w;
        for (int i = 0; i < copy_w; i++)
            dst[i] = vb_bus_px(src[i]);
    }
}

/* ── The instruments (T4.4) ──────────────────────────────── */

static float g_i3v3_ma;      /* estimated load, shown on the ammeter */
static float g_iaudio_ma;

static void vb_draw_instruments(void) {
    /* strip background */
    for (int y = SIM_LCD_HEIGHT; y < VB_WIN_H; y++)
        for (int x = 0; x < VB_WIN_W; x++)
            g_framebuffer[y * VB_WIN_W + x] =
                (y == SIM_LCD_HEIGHT) ? COL_DIM : COL_BG;

    char line[96];
    int ty = SIM_LCD_HEIGHT + 5;

    /* rails — every figure derived (vbench_board.h notes the source) */
    float ocv = vb_ocv(g_soc);
    float i_bat_ma = 0.0f, sag_mv = 0.0f;
    if (g_source == SRC_BATTERY) {
        float v3 = VB_RAIL_3V3_TYP_MV / 1000.0f;
        i_bat_ma = (g_i3v3_ma * v3 / ocv) / 0.90f;      /* boost bound   */
        sag_mv = i_bat_ma * (VB_BAT_R_INT_MOHM + VB_Q1_RDSON_MOHM) / 1000.0f;
    }
    snprintf(line, sizeof line,
             "SRC %-3s  SoC %3.0f%%  BAT+ %5.3fV%s  +5V %5.3fV  +3V3 %5.3fV",
             g_source == SRC_USB ? "USB" : "BAT", g_soc * 100.0f,
             ocv - sag_mv / 1000.0f,
             g_source == SRC_BATTERY ? "*" : " ",
             g_source == SRC_USB ? VB_RAIL_5V_MV / 1000.0f
                                 : VB_RAIL_5V_MV / 1000.0f,
             VB_RAIL_3V3_TYP_MV / 1000.0f);
    vb_text(8, ty, line, COL_TXT); ty += 11;
    snprintf(line, sizeof line,
             "+3V3 band %4d..%4d mV (V_REF tol only)   VBUS %s",
             VB_RAIL_3V3_MIN_MV, VB_RAIL_3V3_MAX_MV,
             g_source == SRC_USB ? "5.000V" : "float");
    vb_text(8, ty, line, COL_DIM); ty += 11;

    /* currents + junction temperatures */
    float i_a = g_i3v3_ma / 1000.0f;
    float p_u3 = i_a * i_a * (VB_U3_R_COND_MOHM / 1000.0f);
    float tj_u3 = VB_AMBIENT_C + p_u3 * VB_U3_THETA_JA;
    float i_bat_a = i_bat_ma / 1000.0f;
    float p_q1 = i_bat_a * i_bat_a * (VB_Q1_RDSON_MOHM / 1000.0f);
    float tj_q1 = VB_AMBIENT_C + p_q1 * VB_Q1_THETA_JA;
    snprintf(line, sizeof line,
             "I(3V3) %3.0fmA  I(audio) %4.1fmA  Tj U3 %4.1fC  Q1 %4.1fC  amb %2.0fC",
             g_i3v3_ma, g_iaudio_ma, tj_u3, tj_q1, VB_AMBIENT_C);
    vb_text(8, ty, line, tj_u3 < VB_U3_TJ_MAX_C - 25.0f ? COL_TXT : COL_BAD);
    ty += 11;

    /* boot + as-built facts */
    snprintf(line, sizeof line, "BOOT %-20s  VDD_SPI %.1fV  EN %s",
             g_download_mode ? "JOINT DOWNLOAD BOOT" : VB_BOOT_MODE_DEFAULT,
             VB_VDD_SPI_MV / 1000.0f,
             VB_EN_FLOATING ? "FLOATING (R25-CRIT-1)" : "held");
    vb_text(8, ty, line, g_download_mode ? COL_WARN : COL_TXT); ty += 11;

    if (!g_sw_pwr_on && VB_SWITCH_CUTS_5V)
        snprintf(line, sizeof line,
                 "SW16 OFF - +5V GATED OFF BY Q2%s",
                 VB_SWITCH_IN_CELL_PATH ? "" : " (IP5306 STILL CHARGING)");
    else
        snprintf(line, sizeof line, "SW16 %s", g_sw_pwr_on ? "ON" : "OFF");
    vb_text(8, ty, line, g_sw_pwr_on ? COL_TXT : COL_WARN); ty += 11;

    snprintf(line, sizeof line, "CALIBRATION: %s (model, not measurement - T5.4)",
             VB_CALIBRATION);
    vb_text(8, ty, line, COL_WARN); ty += 13;

    vb_text(8, ty, "F1 src  F2/F3 SoC  F5 reset(+Select=DL)  P sw_pwr  Esc back",
            COL_DIM);
}

void sim_display_flush(void) {
    if (g_download_mode) {
        /* boot ROM screen — the app is not drawing */
        for (int y = 0; y < SIM_LCD_HEIGHT; y++)
            for (int x = 0; x < VB_WIN_W; x++)
                g_framebuffer[y * VB_WIN_W + x] = RGB565(10, 10, 30);
        vb_text(96, 140, "JOINT DOWNLOAD BOOT", COL_WARN);
        vb_text(56, 156, "GPIO0=0 at reset (SELECT held) - table 6 p.14", COL_DIM);
        vb_text(96, 172, "press F5 to reset into SPI Boot", COL_DIM);
    }
    if (!VB_LCD_MODE_8080_8BIT) {
        vb_text(72, 140, "PANEL MODE MISMATCH: IM straps do not", COL_BAD);
        vb_text(72, 156, "select 8080 8-bit - no picture", COL_BAD);
    }
    vb_draw_instruments();
    SDL_UpdateTexture(g_texture, NULL, g_framebuffer, VB_WIN_W * sizeof(uint16_t));
    SDL_RenderClear(g_renderer);
    SDL_RenderCopy(g_renderer, g_texture, NULL, NULL);
    SDL_RenderPresent(g_renderer);
}

void sim_display_destroy(void) {
    if (g_texture)  SDL_DestroyTexture(g_texture);
    if (g_renderer) SDL_DestroyRenderer(g_renderer);
    if (g_window)   SDL_DestroyWindow(g_window);
}

/* ── Buttons through the RC network ──────────────────────── */

static const struct { SDL_Scancode key; int bit; } KEYMAP[] = {
    { SDL_SCANCODE_W, 0 }, { SDL_SCANCODE_S, 1 },
    { SDL_SCANCODE_A, 2 }, { SDL_SCANCODE_D, 3 },
    { SDL_SCANCODE_J, 4 }, { SDL_SCANCODE_K, 5 },
    { SDL_SCANCODE_U, 6 }, { SDL_SCANCODE_I, 7 },
    { SDL_SCANCODE_RETURN, 8 }, { SDL_SCANCODE_BACKSPACE, 9 },
    { SDL_SCANCODE_Q, 10 }, { SDL_SCANCODE_E, 11 },
};
#define KEYMAP_COUNT (sizeof(KEYMAP) / sizeof(KEYMAP[0]))

uint16_t sim_buttons_read(void) {
    /* Apply pending RC releases: the node reads LOW until it has risen to
     * 70% of the rail, VB_BTN_T_RISE_US after the switch opened. */
    uint64_t now = SDL_GetPerformanceCounter();
    for (int b = 0; b < 12; b++) {
        if (g_btn_release_at[b] && now >= g_btn_release_at[b]) {
            g_btn_state &= (uint16_t)~(1u << b);
            g_btn_release_at[b] = 0;
        }
    }
    return g_btn_state;
}

bool sim_quit_requested(void) { return g_quit; }
bool sim_back_requested(void) {
    if (g_back) { g_back = false; return true; }
    return false;
}

/* ── Audio: level feeds the ammeter ──────────────────────── */

static SDL_AudioDeviceID g_audio_dev = 0;

int sim_audio_init(void) {
    SDL_AudioSpec want, have;
    SDL_zero(want);
    want.freq = SIM_AUDIO_RATE;
    want.format = AUDIO_S16SYS;
    want.channels = SIM_AUDIO_CHANNELS;
    want.samples = 1024;
    g_audio_dev = SDL_OpenAudioDevice(NULL, 0, &want, &have, 0);
    if (g_audio_dev == 0) {
        fprintf(stderr, "SDL_OpenAudioDevice: %s\n", SDL_GetError());
        return -1;
    }
    SDL_PauseAudioDevice(g_audio_dev, 0);
    return 0;
}

void sim_audio_write(const int16_t *samples, int count) {
    if (count > 0) {
        /* RMS of this buffer -> output power -> rail current, using only
         * derived figures: full scale is the swing the supply allows. */
        double acc = 0.0;
        for (int i = 0; i < count; i++)
            acc += (double)samples[i] * samples[i];
        double level = sqrt(acc / count) / 32768.0;           /* 0..~0.707 */
        g_audio_level = (float)level;
        double p_out = level * level * (VB_AUDIO_P_MAX_MW / 1000.0);
        g_iaudio_ma = (float)(p_out / (VB_AUDIO_ETA * (VB_RAIL_5V_MV / 1000.0))
                              * 1000.0) + VB_AUDIO_I_STANDBY_MA;
    }
    if (g_audio_dev)
        SDL_QueueAudio(g_audio_dev, samples, count * (int)sizeof(int16_t));
}

void sim_audio_destroy(void) {
    if (g_audio_dev) { SDL_CloseAudioDevice(g_audio_dev); g_audio_dev = 0; }
}

/* ── SD ──────────────────────────────────────────────────── */

int sim_sd_init(void) {
    printf("[VBENCH] SD mount: %s (bus wiring checked by make bench-sd)\n",
           SIM_SD_MOUNT);
    return 0;
}

/* ── Main loop ───────────────────────────────────────────── */

int sim_init(void) {
    if (SDL_Init(SDL_INIT_VIDEO | SDL_INIT_AUDIO | SDL_INIT_EVENTS) != 0) {
        fprintf(stderr, "SDL_Init: %s\n", SDL_GetError());
        return -1;
    }
    if (sim_audio_init() != 0)
        printf("[VBENCH] WARNING: audio device unavailable\n");
    if (sim_sd_init() != 0) return -1;
    g_i3v3_ma = (float)VB_I_GAMING_MA;
    g_iaudio_ma = VB_AUDIO_I_STANDBY_MA;
    printf("[VBENCH] F1 usb/bat  F2/F3 SoC  F5 reset (Select held = download)"
           "  P sw_pwr\n");
    return 0;
}

void sim_poll_events(void) {
    SDL_Event e;
    while (SDL_PollEvent(&e)) {
        switch (e.type) {
        case SDL_QUIT:
            g_quit = true;
            break;
        case SDL_KEYDOWN:
        case SDL_KEYUP: {
            bool pressed = (e.type == SDL_KEYDOWN);
            SDL_Scancode sc = e.key.keysym.scancode;

            if (pressed && sc == SDL_SCANCODE_ESCAPE) { g_back = true; break; }
            if (pressed && sc == SDL_SCANCODE_F1)
                g_source = (g_source == SRC_USB) ? SRC_BATTERY : SRC_USB;
            if (pressed && sc == SDL_SCANCODE_F2)
                g_soc = g_soc > 0.05f ? g_soc - 0.05f : 0.0f;
            if (pressed && sc == SDL_SCANCODE_F3)
                g_soc = g_soc < 0.95f ? g_soc + 0.05f : 1.0f;
            if (pressed && sc == SDL_SCANCODE_P)
                g_sw_pwr_on = !g_sw_pwr_on;   /* gates +5V through Q2; the
                                                 cell path is untouched */
            if (pressed && sc == SDL_SCANCODE_F5) {
                /* reset: sample the strapping pins NOW (table 6, p.14) */
                bool select_held = (g_btn_state >> 9) & 1;
                g_download_mode = select_held;
                printf("[VBENCH] reset: GPIO0=%d -> %s\n", !select_held,
                       select_held ? "Joint Download Boot" : "SPI Boot");
            }

            for (int i = 0; i < (int)KEYMAP_COUNT; i++) {
                if (sc != KEYMAP[i].key) continue;
                int bit = KEYMAP[i].bit;
                if (pressed) {
                    /* the switch shorts the node: LOW is immediate */
                    g_btn_state |= (uint16_t)(1u << bit);
                    g_btn_release_at[bit] = 0;
                } else if (VB_BTN_RC_MASK & (1u << bit)) {
                    /* release rises through the RC: HIGH after t_rise */
                    uint64_t f = SDL_GetPerformanceFrequency();
                    g_btn_release_at[bit] = SDL_GetPerformanceCounter()
                        + (uint64_t)((double)VB_BTN_T_RISE_US * 1e-6 * (double)f);
                } else {
                    /* no external RC (BTN_L): internal pull only, instant */
                    g_btn_state &= (uint16_t)~(1u << bit);
                }
                break;
            }
            break;
        }
        }
    }
}

void sim_shutdown(void) {
    sim_audio_destroy();
    sim_display_destroy();
    SDL_Quit();
}

#endif /* SIM_BUILD */
